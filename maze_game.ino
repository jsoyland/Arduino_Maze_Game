#include "SPI.h"
#include "Adafruit_GFX.h"
#include "Adafruit_ILI9341.h"

#define TFT_DC 9
#define TFT_CS 10
Adafruit_ILI9341 tft = Adafruit_ILI9341(TFT_CS, TFT_DC);
#define  CLK_PIN   13
#define DATA_PIN  11
#define CS_PIN    10

#define VERT_PIN A1
#define HORZ_PIN A0
#define SEL_PIN  0 // Was originally D2 but I made a mistake on the PCB.  In a stroke of luck D0 works.

int x = 0;
int y = 0;

int x_pos = 0;
int y_pos = 0;

//display is 320x240 so a pixelsize of 8 means we can do 40 x 30 

#define MAZEWIDTH  320//40*8
#define MAZEHEIGHT 240//30*8
#define PIXELSIZE  1


void setup() {
  tft.begin();

  pinMode(VERT_PIN, INPUT);
  pinMode(HORZ_PIN, INPUT);
  pinMode(SEL_PIN, INPUT_PULLUP);
  tft.setRotation(3);             // https://learn.adafruit.com/adafruit-gfx-graphics-library/rotating-the-display
  tft.fillScreen(ILI9341_BLACK);
//  drawMaze();
}

//https://www.youtube.com/watch?v=eBuFZ2glyvc

void loop() {
  int horz = analogRead(HORZ_PIN);
  int vert = analogRead(VERT_PIN);

/*
  tft.setCursor(10, 100);
  tft.setTextColor(ILI9341_RED, ILI9341_YELLOW);
  tft.setTextSize(3);
  tft.println("X: " + String(x_pos) + "    "  + "\n horz: " + String(horz) + "    ");
  tft.setCursor(10, 200);
  tft.setTextColor(ILI9341_BLUE, ILI9341_YELLOW);
  tft.println("Y: " + String(y_pos) + "    " + "\n vert: " + String(vert) + "    ");
*/

if ((horz > 550) && (x_pos >= 0)) {
  x_pos=x_pos - PIXELSIZE;
}
if ((horz < 450) && (x_pos <= MAZEWIDTH)) {
  x_pos = x_pos + PIXELSIZE;
}
if ((vert > 550) && (y_pos <= MAZEHEIGHT)){
  y_pos=y_pos + PIXELSIZE;
}
if ((vert < 450) && (y_pos >= 0)){
  y_pos = y_pos - PIXELSIZE;
}


tft.fillRect((x_pos), (y_pos), PIXELSIZE, PIXELSIZE, ILI9341_GREEN);

  if (digitalRead(SEL_PIN) == LOW) {
    tft.fillScreen(ILI9341_BLACK);
  }
  delay(10);
}







bool Maze[] = {
  1,0,1,0,1,0,1,0,1,0,1,0,1,0,1,0,1,0,1,0,1,0,1,0,1,0,1,0,1,0,1,0,1,0,1,0,1,0,1,0, 
  0,1,1,1,1,1,1,1,1,1,1,1,1,1,1,1,1,1,1,1,1,1,1,1,1,1,1,1,1,1,1,1,1,1,1,1,1,1,1,1,
  1,1,1,1,1,1,1,1,1,1,1,1,1,1,1,1,1,1,1,1,1,1,1,1,1,1,1,1,1,1,1,1,1,1,1,1,1,1,1,0,
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  0,1,0,1,0,1,0,1,0,1,0,1,0,1,0,1,0,1,0,1,0,1,0,1,0,1,0,1,0,1,0,1,0,1,0,1,0,1,0,1
};


void drawMaze(){
  uint16_t x, y;
  bool wall;
  
  for(x=0;x<MAZEWIDTH;x++){
    for(y=0;y<MAZEHEIGHT;y++){
      wall=readPixel(x,y);
      if (wall){
        tft.fillRect((x*PIXELSIZE), (y*PIXELSIZE), PIXELSIZE, PIXELSIZE, ILI9341_YELLOW);
      }
    }
  }

}

bool readPixel(uint16_t x, uint16_t y){
  return Maze[(y*MAZEWIDTH)+x];
}
